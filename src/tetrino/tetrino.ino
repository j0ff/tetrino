
//imports the SPI library (needed to communicate with Gamebuino's screen)
#include <SPI.h>
//imports the Gamebuino library
#include <Gamebuino.h>
//imports Simple Tetris Clone (STC) library
#include "game.h"
#include "gb_platform.h"

//creates a Gamebuino object named gb
Gamebuino gb;
// STC game object
stc::Game game;
// Gamebuino Platform object
stc::PlatformGB platform;

// logo bitmap
const byte logo[] PROGMEM = {64,30,0x0,0x8,0x0,0x8,0x0,0x80,0x0,0x0,0x0,0x8,0x0,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0x0,};

// the setup routine runs once when Gamebuino starts up
void setup(){
  // initialize the Gamebuino object
  gb.begin();
  // shows the start menu
  gb.titleScreen(F("Tetrino by Joff (STC)"), logo);
  
  // Initialize game
  platform.setGamebuinoRef(&gb);
  game.init(&platform);
}

// the loop routine runs over and over again forever
void loop(){
  //updates the gamebuino (the display, the sound, the auto backlight... everything)
  //returns true when it's time to render a new frame (20 times/second)
  if(gb.update())
  {
    game.update();
        
    int errorCode;
    errorCode = game.errorCode();
    if (errorCode == stc::Game::ERROR_PLAYER_QUITS)
    {
      // User quits - prepare for restart
      game.end();
      game.init(&platform);
      gb.titleScreen(F("Tetrino by Joff (STC)"), logo);
    }
    else if (errorCode != stc::Game::ERROR_NONE)
    {
      // Game was interrupted or an error happened, end the game
      game.end();
      gb.titleScreen(F("Tetrino by Joff (STC)"), logo);
    }
  }
}

